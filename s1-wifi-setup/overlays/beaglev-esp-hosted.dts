/dts-v1/;
/plugin/;

/* ESP32 WiFi on SPI0 - BeagleV-Fire */

/ {
    compatible = "microchip,mpfs-beaglev-fire";
};

&{/soc/spi@20108000} {
    status = "okay";
    
    esp32@0 {
        compatible = "espressif,esp32";
        reg = <0>;
        spi-max-frequency = <10000000>;
        spi-cpha;
        spi-cpol;
        
        /* GPIO_2 control pins */
        reset-gpios = <0x13 0x02 0x01>;      /* P8_05 */
        handshake-gpios = <0x13 0x00 0x00>;  /* P8_03 */
        interrupt-parent = <0x13>;
        interrupts = <0x01 0x02>;             /* P8_04 */
    };
};

